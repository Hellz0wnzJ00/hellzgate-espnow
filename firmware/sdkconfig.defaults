## firmware/sdkconfig.defaults
```kconfig
CONFIG_IDF_TARGET="esp32c5"

CONFIG_ESP_CONSOLE_UART_DEFAULT=y

CONFIG_ESPTOOLPY_FLASHSIZE_16MB=y
CONFIG_ESPTOOLPY_FLASHSIZE="16MB"

CONFIG_ESPTOOLPY_HEADER_FLASHSIZE_UPDATE=y

CONFIG_PARTITION_TABLE_CUSTOM=y
CONFIG_PARTITION_TABLE_CUSTOM_FILENAME="partitions.csv"

CONFIG_SPIRAM=y

CONFIG_BT_ENABLED=y
CONFIG_BT_NIMBLE_ENABLED=y
CONFIG_BT_NIMBLE_ROLE_OBSERVER=y
CONFIG_BT_NIMBLE_ROLE_CENTRAL=n
CONFIG_BT_NIMBLE_ROLE_PERIPHERAL=n
CONFIG_BT_NIMBLE_ROLE_BROADCASTER=n

CONFIG_BT_NIMBLE_LOG_LEVEL_WARNING=y

CONFIG_FATFS_LFN_HEAP=y
CONFIG_FATFS_MAX_LFN=64
```
